## boards/arm/de60fs_rev1/Kconfig.board
```kconfig
# Copyright (c) 2024 The ZMK Contributors
# SPDX-License-Identifier: Apache-2.0

config BOARD_DE60FS_REV1
    bool "Deemen17 De60fs Rev.1"
    depends on SOC_RP2040
```

## boards/arm/de60fs_rev1/Kconfig.defconfig
```kconfig
# Copyright (c) 2024 The ZMK Contributors
# SPDX-License-Identifier: MIT

if BOARD_DE60FS_REV1

config ZMK_KEYBOARD_NAME
    default "Deemen17 De60fs Rev.1"

config RP2_FLASH_W25Q080
    default y

endif # BOARD_DE60FS_REV1
```

## boards/arm/de60fs_rev1/de60fs_rev1_defconfig
```kconfig
# Copyright (c) 2024 The ZMK Contributors
# SPDX-License-Identifier: MIT

CONFIG_SOC_SERIES_RP2XXX=y
CONFIG_SOC_RP2040=y
CONFIG_BOARD_DE60FS_REV1=y

CONFIG_SYS_CLOCK_HW_CYCLES_PER_SEC=125000000

# Enable USB CDC ACM logging for debugging
# CONFIG_ZMK_USB_LOGGING=y

# Enable reset by default
CONFIG_RESET=y

# Code partition needed to target the correct flash range
CONFIG_USE_DT_CODE_PARTITION=y

# Output UF2 by default, native bootloader supports it.
CONFIG_BUILD_OUTPUT_UF2=y

CONFIG_ZMK_USB=y

CONFIG_ZMK_KSCAN_MATRIX_POLLING=y 

CONFIG_USB_DEVICE_VID=0xDE17
CONFIG_USB_DEVICE_PID=0x0001

# Enable RGB Ungerglow
CONFIG_ZMK_RGB_UNDERGLOW=n
CONFIG_WS2812_STRIP=n
```
